## TestSoftware/sdk/combination/combination_player/combi_player-defconfig
```kconfig
CONFIG_LCD_ON_EXTENSION_BOARD=y
CONFIG_CXD56_SPH=y
CONFIG_CXD56_SDIO=y
CONFIG_CXD56_SDIO_DMA=y
CONFIG_CXD56_SDIO_DISABLE_CD_WP=y
CONFIG_CXD56_SPI=y
CONFIG_CXD56_SPI4=y
CONFIG_CXD56_DMAC_SPI4_TX=y
CONFIG_CXD56_DMAC_SPI4_TX_CH=2
CONFIG_CXD56_DMAC_SPI4_TX_MAXSIZE=192000
CONFIG_CXD56_DMAC_SPI4_RX=y
CONFIG_CXD56_DMAC_SPI4_RX_CH=3
CONFIG_CXD56_DMAC_SPI4_RX_MAXSIZE=192000
CONFIG_CXD56_SPI5=y
CONFIG_CXD56_SPI5_PINMAP_EMMC=y
CONFIG_CXD56_DMAC_SPI5_TX=y
CONFIG_CXD56_DMAC_SPI5_TX_CH=4
CONFIG_CXD56_DMAC_SPI5_TX_MAXSIZE=2064
CONFIG_CXD56_DMAC_SPI5_RX=y
CONFIG_CXD56_DMAC_SPI5_RX_CH=5
CONFIG_CXD56_DMAC_SPI5_RX_MAXSIZE=2064
CONFIG_CXD56_I2C=y
CONFIG_CXD56_I2C0=y
CONFIG_CXD56_I2C0_SCUSEQ=y
CONFIG_CXD56_I2C2=y


CONFIG_CXD56_DECI_GYRO=y
CONFIG_CXD56_DECI_ACCEL=y
CONFIG_CXD56_CISIF=y

CONFIG_CXD56_AUDIO=y
CONFIG_CXD56_I2S0=y

CONFIG_CXD56_AUDIO_ANALOG_CXD5247=y
CONFIG_CXD56_AUDIO_XTAL_SEL_49_152MHZ=y
CONFIG_CXD56_AUDIO_MICBIAS_20V=y
CONFIG_CXD56_AUDIO_MIC_CHANNEL_SEL=0xFFFF4321
CONFIG_CXD56_AUDIO_MCLKOUT_WEAKEST=y
CONFIG_CXD56_AUDIO_CLKOUT_DMIC_WEAKEST=y
CONFIG_CXD56_AUDIO_DA_DATA_WEAKEST=y
CONFIG_CXD56_AUDIO_GPO_A_WEAKEST=y
CONFIG_CXD56_AUDIO_CIC_IN_SEL_CXD=y
CONFIG_CXD56_AUDIO_PDM_LOWEMI_2MA=y
CONFIG_CXD56_AUDIO_HPADC_MIC_BIAS_OFF=y
CONFIG_CXD56_CXD5247_VER_ES4=y
CONFIG_CXD56_AUDIO_SP_SPLIT_SHORTEST=y
CONFIG_CXD56_AUDIO_SP_DRV_LINEOUT=y

CONFIG_CXD56_AUDIO_I2S_DEVICE_1_SLAVE=y
CONFIG_CXD56_AUDIO_I2S_FORMAT_1_I2S=y
CONFIG_CXD56_AUDIO_I2S_BYPASS_MODE_1_DISABLE=y
CONFIG_CXD56_AUDIO_I2S_RATE_1=48000
CONFIG_CXD56_AUDIO_I2S_LOWEMI_2MA=y
CONFIG_CXD56_AUDIO_ALC_SPC_SEL_OFF=y
CONFIG_CXD56_AUDIO_DMA_DATA_FORMAT_RL=y
CONFIG_CXD56_AUDIO_MIC_BOOT_WAIT=1100

CONFIG_CXD56_LTE=y
CONFIG_CXD56_LTE_SPI4=y
CONFIG_CXD56_LTE_SPI4_DMAC=y




CONFIG_SENSORS=y
CONFIG_BMI160=y
CONFIG_BMI160_I2C=y
CONFIG_BMI160_SCU=y
CONFIG_LCD=y
CONFIG_LCD_ILI9340=y
CONFIG_LCD_ILI9340_NINTERFACES=1
CONFIG_LCD_ILI9340_IFACE0=y
CONFIG_LCD_ILI9340_IFACE0_LANDSCAPE=y
CONFIG_LCD_ILI9340_IFACE0_RGB565=y

CONFIG_VIDEO_ISX012=y
#CONFIG_MODEM=y
#CONFIG_MODEM_ALTMDM=y
#CONFIG_MODEM_ALTMDM_PROTCOL_V2_1=y
# CONFIG_MODEM_ALTMDM_DEBUG is not set
# CONFIG_MODEM_ALTMDM_KEEP_WAKE_STATE is not set
#CONFIG_MODEM_ALTMDM_MAX_PACKET_SIZE=2064
#CONFIG_MODEM_ALTMDM_SLEEP_TIMER_VAL=20


CONFIG_SENSING_MANAGER=y
CONFIG_CXD56_GNSS=y

CONFIG_CXD56_GNSS_NPOLLWAITERS=4
CONFIG_CXD56_GNSS_NSIGNALRECEIVERS=4
CONFIG_CXD56_GNSS_WORKER_STACKSIZE=128
CONFIG_CXD56_GNSS_WORKER_THREAD_PRIORITY=255
CONFIG_CXD56_GNSS_BACKUP_FILENAME="/mnt/spif/gnss_backup.bin"
CONFIG_CXD56_GNSS_CEP_FILENAME="/mnt/vfat/gnss_cep.bin"
CONFIG_CXD56_GEOFENCE=y
CONFIG_GPSUTILS_CXD56NMEA_LIB=y

CONFIG_SENSING_STEPCOUNTER=y
CONFIG_SDK_AUDIO=y

CONFIG_AUDIOUTILS_MANAGER=y
CONFIG_AUDIOUTILS_PLAYER=y
CONFIG_AUDIOUTILS_PLAYLIST=y

CONFIG_AUDIOUTILS_PLAYER_CODEC_PCM=y
CONFIG_AUDIOUTILS_PLAYER_CODEC_MP3=y
CONFIG_AUDIOUTILS_PLAYER_CODEC_AAC=y
CONFIG_AUDIOUTILS_PLAYER_CODEC_OPUS=y
CONFIG_AUDIOUTILS_RENDERER_CH_NUM=2
CONFIG_AUDIOUTILS_DSP_MOUNTPT="/mnt/spif/BIN"

CONFIG_AUDIOUTILS_DECODER=y
CONFIG_AUDIOUTILS_POSTPROC=y
CONFIG_AUDIOUTILS_RENDERER=y
CONFIG_AUDIOUTILS_COMPONENT_COMMON=y
CONFIG_AUDIOUTILS_DSP_DRIVER=y
CONFIG_MEMUTILS=y

CONFIG_MEMUTILS_MEMORY_MANAGER=y
CONFIG_MEMUTILS_MEMORY_MANAGER_USE_FENCE=y
CONFIG_MEMUTILS_MEMORY_MANAGER_NUM_FIXED_AREA_FENCES=0
CONFIG_MEMUTILS_MESSAGE=y
CONFIG_MEMUTILS_S_STL=y
CONFIG_MEMUTILS_SIMPLE_FIFO=y
CONFIG_ASMP=y
CONFIG_MM_TILE=y
CONFIG_ASMP_MEMSIZE=0xC0000




CONFIG_LTE=y
CONFIG_MODEM_DEVICE_PATH="/dev/altmdm"
CONFIG_LTE_NET=y
CONFIG_LTE_INET=y
CONFIG_LTE_INET_ATON=y
CONFIG_LTE_NETDB=y

CONFIG_VIDEO=y


CONFIG_NETUTILS_NETLIB=y
CONFIG_NETUTILS_WEBCLIENT=y
CONFIG_NSH_WGET_USERAGENT="NuttX/6.xx.x (; http://www.nuttx.org/)"
CONFIG_WEBCLIENT_TIMEOUT=10
CONFIG_NETUTILS_WEBCLIENT_TLS_CERTS_PATH="/mnt/spif/CERTS"



CONFIG_EXTERNALS_LIBJPEG=y
CONFIG_EXTERNALS_MBEDTLS=y



CONFIG_COMBINATION_PLAYER=y
CONFIG_COMBINATION_PLAYER_WORKER_STACKSIZE=2048
CONFIG_EXAMPLES_SENSOR_STEP_COUNTER_ACCEL_WM_SIGNO=14

#CONFIG_COMBI_SET_PLAY_ONLY=y
#CONFIG_COMBI_SET_STEP_ONLY=y
CONFIG_COMBI_SET_PLAY_W_STEP=y

CONFIG_COMBI_SET_AUDIO=y
CONFIG_COMBI_SET_STEP=y

CONFIG_COMBI_SET_LED=y
CONFIG_COMBI_SET_GNSS=y
CONFIG_COMBI_SET_VIDEO=y
CONFIG_COMBI_SET_CAMERA=y
CONFIG_COMBI_SET_ASMP=y
CONFIG_COMBI_SET_DECODE=y
CONFIG_COMBI_SET_FLASH=y
CONFIG_COMBI_SET_FAT=y
#CONFIG_COMBI_SET_LTE=y
#CONFIG_EXAMPLES_JPEG_DECODE_OUTPUT_LCD=y
```

## TestSoftware/sdk/combination/combination_recorder/Kconfig
```kconfig
#
# For a description of the syntax of this configuration file,
# see the file kconfig-language.txt in the NuttX tools repository.
#

config COMBINATION_RECORDER
	bool "Combination of audioRecorder, Gnss, Led, Camera and Multicpu"
	default n
	---help---
		Enable the Combination of audioRecorder, Gnss, Led, Camera and Multicpu

if COMBINATION_RECORDER

config COMBINATION_RECORDER_WORKER_STACKSIZE
    int "Example worker stack size"
    default 2048

config EXAMPLES_SENSOR_STEP_COUNTER_ACCEL_WM_SIGNO
    int "Accelerator sensor watermark signal"
    default 14

choice
    prompt "recorder and step selection"
    default COMBI_SET_REC_W_STEP
    ---help---
        Set the compile option of recorder or step.

config COMBI_SET_REC_W_STEP
    bool "REC_W_STEP"

config COMBI_SET_REC_ONLY
    bool "REC_ONLY"

config COMBI_SET_STEPCNT_ONLY
    bool "STEP_ONLY"
endchoice

config COMBI_SET_LTE
    bool "lte"
    default n

config COMBI_SET_LED
    bool "led"
    default n

config COMBI_SET_GNSS
    bool "gnss"
    default n

config COMBI_SET_AUDIO
    bool "audio"
    default y

config COMBI_SET_VIDEO
    bool "video"
    default n

config COMBI_SET_CAMERA
    bool "camera"
    default n

config COMBI_SET_ASMP
    bool "asmp"
    default n

config COMBI_SET_DECODE
    bool "decode"
    default n

config COMBI_SET_STEP
    bool "step"
    default n

config COMBI_SET_FLASH
    bool "flash"
    default n

config COMBI_SET_FAT
    bool "fat"
    default n

endif
```

## TestSoftware/sdk/combination/httpc/Kconfig
```kconfig
#
# For a description of the syntax of this configuration file,
# see the file kconfig-language.txt in the NuttX tools repository.
#

menuconfig NETUTILS_HTTPC
	bool "HTTP client support"
	default n
	select NET_LWIP
	---help---
		Enable or Disable HTTP client feature

if NETUTILS_HTTPC
config NETUTILS_HTTPC_ROOTCA_USE_FILE
	bool "Use root CA certificate file in mbedTLS certification"
	default n
	depends on NETUTILS_MBEDTLS
	---help---
		In case NETUTILS_HTTPC_ROOTCA_USE_FILE=n, this application use the root CA
		 certificate information on memory(defined in rootca_certs.c) in mbedTLS certification.

if NETUTILS_HTTPC_ROOTCA_USE_FILE
config NETUTILS_HTTPC_ROOTCA_FILE
	string "root CA file path in mbedTLS certification"
	default "/mnt/spif/GeoTrust.crt"
	---help---
		Need to put the root CA file to NETUTILS_HTTPC_ROOTCA_FILE path.
endif
endif
```
