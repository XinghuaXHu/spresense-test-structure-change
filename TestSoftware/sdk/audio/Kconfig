## TestSoftware/sdk/audio/audio_extensions_test/Kconfig
```kconfig
#
# For a description of the syntax of this configuration file,
# see the file kconfig-language.txt in the NuttX tools repository.
#

config AUDIO_EXTENSIONS_TEST
	bool "Audio extensions test"
	default n
	depends on CXD56_AUDIO
	---help---
		Enable the audio extensions test
```

## TestSoftware/sdk/audio/audio_player/Kconfig
```kconfig
#
# For a description of the syntax of this configuration file,
# see the file kconfig-language.txt in the NuttX tools repository.
#

config SQA_TEST_AUDIO_PLAYER
    bool "Audio player test"
    default n

if SQA_TEST_AUDIO_PLAYER

config SQA_TEST_AUDIO_PLAYER_FILE_MOUNTPT
	string "play file mount path"
	default "/mnt/sd0/AUDIO"
	---help---
		The path to the play file mount point. Default: /mnt/sd0/AUDIO

config SQA_TEST_AUDIO_PLAYER_USE_SUBPLAYER
    bool "Use subplayer" 
    default y
    ---help---
        Use subplayer or not

endif
```

## TestSoftware/sdk/audio/audio_player_extensions/player_test/Kconfig
```kconfig
#
# For a description of the syntax of this configuration file,
# see the file kconfig-language.txt in the NuttX tools repository.
#

config EXAMPLES_PLAYER_TEST
	bool "Audio player test"
	default n
	depends on CXD56_AUDIO
	---help---
		Enable the audio player test
```

## TestSoftware/sdk/audio/audio_player_loop/Kconfig
```kconfig
#
# For a description of the syntax of this configuration file,
# see the file kconfig-language.txt in the NuttX tools repository.
#

config SQA_TEST_AUDIO_PLAYER_LOOP
	bool "Audio player loop test"
	default n
	depends on CXD56_AUDIO
	---help---
		Enable the audio player loop test
```

## TestSoftware/sdk/audio/audio_player_with_usbmsc/Kconfig
```kconfig
#
# For a description of the syntax of this configuration file,
# see the file kconfig-language.txt in the NuttX tools repository.
#

config SQA_TEST_AUDIO_PLAYER_WITH_USBMSC
	bool "Audio player with usbmsc"
	default n
	depends on CXD56_AUDIO
	---help---
		Enable the audio player with usbmsc
```

## TestSoftware/sdk/audio/audio_recog/Kconfig
```kconfig
#
# For a description of the syntax of this configuration file,
# see the file kconfig-language.txt in the NuttX tools repository.
#

config SQAT_AUDIO_RECOG
	bool "Audio recognizer example"
	default n
	depends on CXD56_AUDIO
	---help---
		Enable the audio recognizer example

if SQAT_AUDIO_RECOG

config SQAT_AUDIO_RECOG_PROGNAME
	string "Program name"
	default "audio_recognizer"

config SQAT_AUDIO_RECOG_PRIORITY
	int "Audio recognizer task priority"
	default 100

config SQAT_AUDIO_RECOG_STACKSIZE
	int "Audio recognizer stack size"
	default 2048

config SQAT_AUDIO_RECOG_USEPREPROC
	bool "Use pre process at Frontend"
	default n

endif
```

## TestSoftware/sdk/audio/audio_recog2/Kconfig
```kconfig
#
# For a description of the syntax of this configuration file,
# see the file kconfig-language.txt in the NuttX tools repository.
#

config SQAT_AUDIO_RECOG2
	bool "Audio recognizer2 example"
	default n
	depends on CXD56_AUDIO
	---help---
		Enable the audio recognizer example

if SQAT_AUDIO_RECOG2

config SQAT_AUDIO_RECOG2_PROGNAME
	string "Program name"
	default "audio_recognizer"

config SQAT_AUDIO_RECOG2_PRIORITY
	int "Audio recognizer task priority"
	default 100

config SQAT_AUDIO_RECOG2_STACKSIZE
	int "Audio recognizer stack size"
	default 2048

config SQAT_AUDIO_RECOG2_USEPREPROC
	bool "Use pre process at Frontend"
	default n

#choice
#	prompt "DSP worker Selection"
#	default SQAT_AUDIO_RECOG2_DSP2

config RECOG2_DSP1
	tristate "using a Default DSP worker"
	default y 

config RECOG2_DSP2
	tristate "using a second DSP worker to exchange"
	default n

config RECOG2_DSP3
	tristate "using a DSP worker for load test"
	default n
#endchoice

#config SQAT_AUDIO_RECOG2_SELECT
#	bool "build RCGPROC2 for another dsp code"
#	default n
endif
```

## TestSoftware/sdk/audio/audio_recorder/Kconfig
```kconfig
#
# For a description of the syntax of this configuration file,
# see the file kconfig-language.txt in the NuttX tools repository.
#

config SQA_TEST_AUDIO_RECORDER
	bool "Audio recorder test"
	default n
#	depends on CXD56_AUDIO
#	---help---
#		Enable the audio player example

if SQA_TEST_AUDIO_RECORDER

config SQA_TEST_AUDIO_RECORDER_PROGNAME
	string "Program name"
	default "audio_recorder"

config SQA_TEST_AUDIO_RECORDER_PRIORITY
	int "Audio recorder task priority"
	default 100

config SQA_TEST_AUDIO_RECORDER_STACKSIZE
	int "Audio recorder stack size"
	default 2048
endif
```

## TestSoftware/sdk/audio/audio_recorder_1_2_1/Kconfig
```kconfig
#
# For a description of the syntax of this configuration file,
# see the file kconfig-language.txt in the NuttX tools repository.
#

config SQA_TEST_AUDIO_RECORDER_1_2_1
	bool "Audio recorder example 1.2.1"
	default n
	depends on CXD56_AUDIO
	---help---
		Enable the audio player example

if SQA_TEST_AUDIO_RECORDER_1_2_1

config SQA_TEST_AUDIO_RECORDER_PROGNAME_1_2_1
	string "Program name"
	default "audio_recorder"

config SQA_TEST_AUDIO_RECORDER_PRIORITY_1_2_1
	int "Audio recorder task priority"
	default 100

config SQA_TEST_AUDIO_RECORDER_STACKSIZE_1_2_1
	int "Audio recorder stack size"
	default 2048
endif
```

## TestSoftware/sdk/audio/audio_recorder_digmic_wav/Kconfig
```kconfig
#
# For a description of the syntax of this configuration file,
# see the file kconfig-language.txt in the NuttX tools repository.
#

config SQA_TEST_AUDIO_RECORDER_DIGMIC_WAV
	bool "Audio recorder test (digital mic wav)"
	default n
	depends on CXD56_AUDIO
	---help---
		Enable the audio player example

if SQA_TEST_AUDIO_RECORDER_DIGMIC_WAV

config SQA_TEST_AUDIO_RECORDER_DIGMIC_WAV_PROGNAME
	string "Program name"
	default "audio_recorder_digmic_wav"

config SQA_TEST_AUDIO_RECORDER_DIGMIC_WAV_PRIORITY
	int "Audio recorder task priority"
	default 100

config SQA_TEST_AUDIO_RECORDER_DIGMIC_WAV_STACKSIZE
	int "Audio recorder stack size"
	default 2048
endif
```

## TestSoftware/sdk/audio/audio_recorder_hi/Kconfig
```kconfig
#
# For a description of the syntax of this configuration file,
# see the file kconfig-language.txt in the NuttX tools repository.
#

config SQA_TEST_AUDIO_RECORDER_HI
	bool "Audio recorder test (Hi-Res)"
	default n
	depends on CXD56_AUDIO
	---help---
		Enable the audio player example

if SQA_TEST_AUDIO_RECORDER_HI

config SQA_TEST_AUDIO_RECORDER_HI_PROGNAME
	string "Program name"
	default "audio_recorder_hi"

config SQA_TEST_AUDIO_RECORDER_HI_PRIORITY
	int "Audio recorder task priority"
	default 100

config SQA_TEST_AUDIO_RECORDER_HI_STACKSIZE
	int "Audio recorder stack size"
	default 2048
endif
```

## TestSoftware/sdk/audio/audio_recorder_hi/defconfig/recorder_hi_test-defconfig
```kconfig
CONFIG_CXD56_SPH=y
CONFIG_CXD56_SDIO=y
CONFIG_CXD56_AUDIO=y
CONFIG_CXD56_I2S0=y
CONFIG_SDK_AUDIO=y
CONFIG_AUDIOUTILS_RECORDER=y
CONFIG_MEMUTILS=y
CONFIG_ASMP=y
CONFIG_SYSTEM_USBMSC=y
CONFIG_SQA_TEST_AUDIO_RECORDER_HI=y
CONFIG_SQA_TEST_AUDIO_RECORDER_HI_PROGNAME="audio_recorder_hi"
CONFIG_SQA_TEST_AUDIO_RECORDER_HI_PRIORITY=100
CONFIG_SQA_TEST_AUDIO_RECORDER_HI_STACKSIZE=2048
```

## TestSoftware/sdk/audio/audio_recorder_hi/defconfig/usbmsc-defconfig
```kconfig
CONFIG_SYSTEM_USBMSC=y
CONFIG_CXD56_SDIO=y
CONFIG_EXAMPLES_AUDIO_PLAYER_MODE_HIRES=y
```

## TestSoftware/sdk/audio/audio_recorder_preproc/Kconfig
```kconfig
#
# For a description of the syntax of this configuration file,
# see the file kconfig-language.txt in the NuttX tools repository.
#

config SQA_TEST_AUDIO_RECORDER_PREPROC
	bool "Audio recorder PreProc"
	default n
	depends on CXD56_AUDIO
	---help---
		Enable the audio recorder PreProc test

if SQA_TEST_AUDIO_RECORDER_PREPROC

config SQA_TEST_AUDIO_RECORDER_PREPROC_PROGNAME
	string "Program name"
	default "audio_recorder"

config SQA_TEST_AUDIO_RECORDER_PREPROC_PRIORITY
	int "Audio recorder task priority"
	default 100

config SQA_TEST_AUDIO_RECORDER_PREPROC_STACKSIZE
	int "Audio recorder stack size"
	default 2048

config SQA_TEST_AUDIO_RECORDER_PREPROC_USEPREPROC
	bool "Use preprocess"
	default n

config SQA_TEST_AUDIO_RECORDER_PREPROC_USBMSC
    bool "Use usbmsc"
    default n

endif
```

## TestSoftware/sdk/audio/audio_recorder_preproc_digmic/Kconfig
```kconfig
#
# For a description of the syntax of this configuration file,
# see the file kconfig-language.txt in the NuttX tools repository.
#

config SQA_TEST_AUDIO_RECORDER_PREPROC_DIGMIC
	bool "Audio recorder PreProc (digital mic)"
	default n
	depends on CXD56_AUDIO
	---help---
		Enable the audio recorder digital mic PreProc test

if SQA_TEST_AUDIO_RECORDER_PREPROC_DIGMIC

config SQA_TEST_AUDIO_RECORDER_PREPROC_DIGMIC_PROGNAME
	string "Program name"
	default "audio_recorder"

config SQA_TEST_AUDIO_RECORDER_PREPROC_DIGMIC_PRIORITY
	int "Audio recorder task priority"
	default 100

config SQA_TEST_AUDIO_RECORDER_PREPROC_DIGMIC_STACKSIZE
	int "Audio recorder stack size"
	default 2048

config SQA_TEST_AUDIO_RECORDER_PREPROC_DIGMIC_USEPREPROC
	bool "Use preprocess"
	default n

config SQA_TEST_AUDIO_RECORDER_PREPROC_DIGMIC_USBMSC
    bool "Use usbmsc"
    default n

endif
```

## TestSoftware/sdk/audio/voice_call/Kconfig
```kconfig
#
# For a description of the syntax of this configuration file,
# see the file kconfig-language.txt in the NuttX tools repository.
#

config TEST_VOICE_CALL
    bool "Audio voice call test"
    default n
    ---help---
        Enable the voice call test

if TEST_VOICE_CALL

config TEST_VOICE_CALL_APP_NAME
	string "Application name"
	default "voice_call"
	
config TEST_VOICE_CALL_PROGNAME
	string "Program name"
	default "voice_call"
	
config TEST_VOICE_CALL_PRIORITY
	int "voice_call task priority"
	default 100

config TEST_VOICE_CALL_STACKSIZE
	int "oice_call stack size"
	default 2048

endif
```

## TestSoftware/sdk/audio/voice_command/Kconfig
```kconfig
#
# For a description of the syntax of this configuration file,
# see the file kconfig-language.txt in the NuttX tools repository.
#

config TEST_VOICE_COMMAND
    bool "Audio voice command test"
    default n
    ---help---
        Enable voice command test

if TEST_VOICE_COMMAND

config TEST_VOICE_COMMAND_APP_NAME
	string "Application name"
	default "voice_command"
	
config TEST_VOICE_COMMAND_PROGNAME
	string "Program name"
	default "voice_command"
	
config TEST_VOICE_COMMAND_PRIORITY
	int "voice_command task priority"
	default 100

config TEST_VOICE_COMMAND_STACKSIZE
	int "voice_command stack size"
	default 2048

endif
```

## TestSoftware/sdk/combination/audio_gnss/Kconfig
```kconfig
#
# For a description of the syntax of this configuration file,
# see the file kconfig-language.txt in the NuttX tools repository.
#

config TEST_AUDIO_GNSS
	bool "AUDIO and GNSS combination test"
	default n
	select FS_NAMED_SEMAPHORES
	select SYSLOG_TIMESTAMP
	select LIBC_STRERROR
	select LIBM
	select LIB_ASMP
	select HAVE_CXX
	select HAVE_CXXINITIALIZE
	select CXD56_AUDIO
	select AUDIOUTILS_FEATURE
	select AUDIOUTILS_PLAYER
	select CXD56_GNSS
	select TEST_COMMON_UTILS
	select TEST_COMMON_GNSS
	select TEST_COMMON_AUDIO
	---help---
		Enable the AUDIO and GNSS combination test
```

## TestSoftware/sdk/combination/camera_jpgdec/Kconfig
```kconfig
#
# For a description of the syntax of this configuration file,
# see the file kconfig-language.txt in the NuttX tools repository.
#

config TEST_CAMERA_JPGDEC
	bool "Test camera and jpegdecoder"
	default n
	---help---
		Enable the test camera and jpegdecoder

if TEST_CAMERA_JPGDEC

config TEST_CAMERA_JPGDEC_PROGNAME
	string "Program name"
	default "camera_jpgdec"
	depends on BUILD_KERNEL
	---help---
		This is the name of the program that will be use when the NSH ELF
		program is installed.

config TEST_CAMERA_JPGDEC_PRIORITY
	int "Camera task priority"
	default 100

config TEST_CAMERA_JPGDEC_STACKSIZE
	int "Camera stack size"
	default 5120

config TEST_JPEG_DECODE_OUTPUT_LCD
	bool "Output LCD"
	default y

config TEST_CAMERA_JPGDEC_INFINITE
	bool "Capture image infinite"
	depends on TEST_CAMERA_JPGDEC_OUTPUT_LCD
	---help---
		Capturing images in infinite loop. If this option is enabled, then
		example never been stopped.

endif
```

## TestSoftware/sdk/combination/combination_player/Kconfig
```kconfig
#
# For a description of the syntax of this configuration file,
# see the file kconfig-language.txt in the NuttX tools repository.
#

config COMBINATION_PLAYER
	bool "Combination of audioPlayer, Gnss, Led, Camera and Multicpu"
	default n
	---help---
		Enable the Combination of audioPlayer, Gnss, Led, Camera and Multicpu

if COMBINATION_PLAYER

config COMBINATION_PLAYER_WORKER_STACKSIZE
    int "Example worker stack size"
    default 2048

config EXAMPLES_SENSOR_STEP_COUNTER_ACCEL_WM_SIGNO
    int "Accelerator sensor watermark signal"
    default 14

choice
    prompt "player and step selection"
    default COMBI_SET_PLAY_W_STEP
    ---help---
        Set the compile option of player or step.

config COMBI_SET_PLAY_ONLY
    bool "COMBI_SET_PLAY_ONLY"

config COMBI_SET_STEP_ONLY
    bool "COMBI_SET_STEP_ONLY"

config COMBI_SET_PLAY_W_STEP
    bool "COMBI_SET_PLAY_W_STEP"
endchoice

config COMBI_SET_LTE
    bool "COMBI_SET_LTE"
    default n

config COMBI_SET_LED
    bool "COMBI_SET_LED"
    default n

config COMBI_SET_GNSS
    bool "COMBI_SET_GNSS"
    default n

config COMBI_SET_AUDIO
    bool "COMBI_SET_AUDIO"
    default n

config COMBI_SET_VIDEO
    bool "COMBI_SET_VIDEO"
    default n

config COMBI_SET_CAMERA
    bool "COMBI_SET_CAMERA"
    default n

config COMBI_SET_ASMP
    bool "COMBI_SET_ASMP"
    default n

config COMBI_SET_DECODE
    bool "COMBI_SET_DECODE"
    default n

config COMBI_SET_STEP
    bool "COMBI_SET_STEP"
    default n

config COMBI_SET_FLASH
    bool "COMBI_SET_FLASH"
    default n

config COMBI_SET_FAT
    bool "COMBI_SET_FAT"
    default n

config EXAMPLES_JPEG_DECODE_OUTPUT_LCD
    bool "EXAMPLES_JPEG_DECODE_OUTPUT_LCD"
    default n

endif
```
