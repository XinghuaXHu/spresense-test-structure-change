## TestSoftware/sdk/other/internal_test/audio/component_test/filter/src_drv_comp_test/Kconfig
```kconfig
#
# For a description of the syntax of this configuration file,
# see the file kconfig-language.txt in the NuttX tools repository.
#

config TEST_SRC_COMPONENT
	bool "src component test"
	default n
	select MEMUTILS_MEMORY_MANAGER
	select MEMUTILS_MESSAGE
	select MEMUTILS_S_STL

config TEST_SRC_COMPONENT_PROGNAME
	string "Program name"
	default "test_src_component"
	depends on TEST_SRC_COMPONENT

config TEST_SRC_COMPONENT_PRIORITY
	int "Test src task priority"
	default 100
	depends on TEST_SRC_COMPONENT

config TEST_SRC_COMPONEN_STACKSIZE
	int "Test src stack size"
	default 4096
	depends on TEST_SRC_COMPONENT

config TEST_SRC_FILE_MOUNTPT
	string "Test contents file mount path"
	default "/mnt/vfat/AUDIO"
	depends on TEST_SRC_COMPONENT
	---help---
		The path to the play file mount point. Default: /mnt/vfat/AUDIO

config AUDIOUTILS_PLAYLIST_PLAYLISTFILE_MOUNTPT
	string "test playlist file mount path"
	default "/mnt/vfat/PLAYLIST"
	depends on TEST_SRC_COMPONENT
	---help---
		The path to the playlist file mount point. Default: /mnt/vfat/PLAYLIST

config AUDIOUTILS_DSP_MOUNTPT
	string "DSP image mount path"
	default "/mnt/vfat/BIN"
	depends on TEST_SRC_COMPONENT
	---help---
		The path to the DSP mount point. Default: /mnt/vfat/BIN"

config TEST_SRC_OUTPUT_FILE_MOUNTPT
	string "recording file mount path"
	default "/mnt/vfat/SRC"
	depends on TEST_SRC_COMPONENT
	---help---
		The path to the recording file mount point. Default: /mnt/vfat/SRC

config AUDIOUTILS_DSP_DEBUG_DUMP
	bool "dsp debug dump"
	default n
	depends on TEST_SRC_COMPONENT && CXD56_LOG
	---help---
		Enable Dsp Debug Dump
```

## TestSoftware/sdk/other/internal_test/audio/configs/corvo/src_component_test-defconfig
```kconfig
CONFIG_BOARD_CORVO=y
CONFIG_CXD56_GNSS=y
CONFIG_MEMUTILS=y
CONFIG_MEMUTILS_SIMPLE_FIFO=y
CONFIG_ASMP=y
CONFIG_TEST_SRC_COMPONENT=y
```

## TestSoftware/sdk/security/security1-3-1/Kconfig
```kconfig
#
# For a description of the syntax of this configuration file,
# see the file kconfig-language.txt in the NuttX tools repository.
#

config TEST_SECURITY_ASMP1-3-1
	bool "Enable some security 1-3-1 tests using extended functions in ASMP"
	default n
```

## TestSoftware/sdk/security/security1-3-1/configs/sec_asmp1-3-1-defconfig
```kconfig
CONFIG_ASMP=y
CONFIG_ASMP_MEMSIZE=0x120000
CONFIG_EXAMPLES_ASMP=y
CONFIG_TEST_SECURITY_ASMP1-3-1=y
```

## TestSoftware/sdk/security/security1-4/Kconfig
```kconfig
#
# For a description of the syntax of this configuration file,
# see the file kconfig-language.txt in the NuttX tools repository.
#

config TEST_SECURITY_ASMP1-4
	bool "Enable some security 1-4 test to check the access protection"
	default n
```

## TestSoftware/sdk/security/security1-4/sec_asmp1-4-defconfig
```kconfig
CONFIG_CXD56_SDIO=y
CONFIG_ASMP=y
CONFIG_ASMP_MEMSIZE=0x100000
CONFIG_EXAMPLES_ASMP=y
CONFIG_TEST_SECURITY_ASMP1-4=y
```

## TestSoftware/sdk/security/security1-5/Kconfig
```kconfig
#
# For a description of the syntax of this configuration file,
# see the file kconfig-language.txt in the NuttX tools repository.
#

config TEST_SECURITY_ASMP1-5
	bool "Enable some security 1-5 test to check the access protection"
	default n
```

## TestSoftware/sdk/system/aca_util/Kconfig
```kconfig
config TEST_ACA_UTIL
	bool "Aca utility tool"
	default n
	---help---
		Enable the aca_util app

if TEST_ACA_UTIL

config TEST_ACA_UTIL_PROGNAME
	string "Program name"
	default "aca_util"
	depends on BUILD_KERNEL
	---help---
		This is the name of the program that will be use when the NSH ELF
		program is installed.

config TEST_ACA_UTIL_PRIORITY
	int "aca_util task priority"
	default 100

config TEST_ACA_UTIL_STACKSIZE
	int "aca_util stack size"
	default 2048

endif
```

## TestSoftware/sdk/system/alarm/Kconfig
```kconfig
#
# For a description of the syntax of this configuration file,
# see the file kconfig-language.txt in the NuttX tools repository.
#

config TEST_ALARM
	bool "RTC alarm driver example"
	default n
	---help---
		Enable the RTC driver alarm test

if TEST_ALARM

config TESTS_ALARM_PROGNAME
	string "Program name"
	default "alarm"
	depends on BUILD_KERNEL
	---help---
		This is the name of the program that will be use when the NSH ELF
		program is installed.

config TEST_ALARM_PRIORITY
	int "Alarm task priority"
	default 100

config TEST_ALARM_STACKSIZE
	int "Alarm stack size"
	default 2048

config TEST_ALARM_DEVPATH
	string "RTC device path"
	default "/dev/rtc0"

config TEST_ALARM_SIGNO
	int "Alarm signal"
	default 1

endif # TEST_ALARM
```

## TestSoftware/sdk/system/charger/Kconfig
```kconfig
#
# For a description of the syntax of this configuration file,
# see the file kconfig-language.txt in the NuttX tools repository.
#

config TEST_CHARGER
	bool "Charger driver test"
	default n
	---help---
		Enable the battery charger driver test

if TEST_CHARGER

config TEST_CHARGER_PROGNAME
	string "Program name"
	default "charger"
	depends on BUILD_KERNEL
	---help---
		This is the name of the program that will be use when the NSH ELF
		program is installed.

config TEST_CHARGER_PRIORITY
	int "Charger task priority"
	default 100

config TEST_CHARGER_STACKSIZE
	int "Charger stack size"
	default 2048

endif
```

## TestSoftware/sdk/system/freqlock_test/Kconfig
```kconfig
#
# For a description of the syntax of this configuration file,
# see the file kconfig-language.txt in the NuttX tools repository.
#

config FREQLOCK_TEST
	bool "Freq lock test"
	default n
	---help---
		Enable the freq test

if FREQLOCK_TEST

config FREQLOCK_TEST_PROGNAME
	string "Program name"
	default "freqlock_test"
	depends on BUILD_KERNEL
	---help---
		This is the name of the program that will be use when the NSH ELF
		program is installed.

config FREQLOCK_TEST_PRIORITY
	int "freqlock test task priority"
	default 100

config FREQLOCK_TEST_STACKSIZE
	int "freqlock test stack size"
	default 2048

config FREQLOCK_TEST_SLEEP_TIME
	int "Freqlock test sleep time"
	default 2

endif
```

## TestSoftware/sdk/system/gauge/Kconfig
```kconfig
#
# For a description of the syntax of this configuration file,
# see the file kconfig-language.txt in the NuttX tools repository.
#

config TEST_GAUGE
	bool "Gauge driver test"
	default n
	---help---
		Enable the battery gauge driver test

if TEST_GAUGE

config TEST_GAUGE_PROGNAME
	string "Program name"
	default "gauge"
	depends on BUILD_KERNEL
	---help---
		This is the name of the program that will be use when the NSH ELF
		program is installed.

config TEST_GAUGE_PRIORITY
	int "Gauge task priority"
	default 100

config TEST_GAUGE_STACKSIZE
	int "Gauge stack size"
	default 2048

endif
```

## TestSoftware/sdk/system/pmic/Kconfig
```kconfig
#
# For a description of the syntax of this configuration file,
# see the file kconfig-language.txt in the NuttX tools repository.
#

config PMIC_TEST
	bool "PMIC power monitor example"
	default n
	depends on CXD56_PMIC
	---help---
		Enable the PMIC power monitor example

if PMIC_TEST

config PMIC_TEST_PROGNAME
	string "Program name"
	default "pmic"
	depends on BUILD_KERNEL
	---help---
		This is the name of the program that will be use when the NSH ELF
		program is installed.

config PMIC_TEST_PRIORITY
	int "pmic task priority"
	default 100

config PMIC_TEST_STACKSIZE
	int "pmic stack size"
	default 2048

endif
```

## TestSoftware/sdk/system/pmtest/Kconfig
```kconfig
#
# For a description of the syntax of this configuration file,
# see the file kconfig-language.txt in the NuttX tools repository.
#

config TEST_PMTEST
	bool "Power management example"
	default n
	---help---
		Enable the power management example

if TEST_PMTEST

config TEST_PMTEST_AUTO_LAUNCH
	bool "Auto launch"
	default n
	depends on !BUILD_PROTECTED && !BUILD_KERNEL

config TEST_PMTEST_PROGNAME
	string "Program name"
	default "pmtest"
	depends on BUILD_KERNEL
	---help---
		This is the name of the program that will be use when the NSH ELF
		program is installed.

config TEST_PMTEST_PRIORITY
	int "pmtest task priority"
	default 100

config TEST_PMTEST_STACKSIZE
	int "pmtest stack size"
	default 2048

endif
```

## TestSoftware/sdk/system/power_test/Kconfig
```kconfig
#
# For a description of the syntax of this configuration file,
# see the file kconfig-language.txt in the NuttX tools repository.
#

config POWER_TEST
	bool "Power test"
	default n
	---help---
		Enable the power test

if POWER_TEST

config POWER_TEST_PROGNAME
	string "Program name"
	default "power_test"
	depends on BUILD_KERNEL
	---help---
		This is the name of the program that will be use when the NSH ELF
		program is installed.

config POWER_TEST_PRIORITY
	int "power_test task priority"
	default 100

config POWER_TEST_STACKSIZE
	int "power_test stack size"
	default 2048

config TEST_MAX_TILE_NUM
	int "Max tile test num"
	default 8

config POWER_TEST_SLEEP_TIME
	int "Power test sleep time"
	default 2

endif
```

## TestSoftware/sdk/system/system_large/Kconfig
```kconfig
#
# For a description of the syntax of this configuration file,
# see the file kconfig-language.txt in the NuttX tools repository.
#

config SQA_SYSTEM_LARGE
    bool "system test for large files..."
	default n
	---help---
		smartFS test

if SQA_SYSTEM_LARGE

config SQA_SYSTEM_PROGNAME
	string "Program name"
	default ""
	depends on BUILD_KERNEL
	---help---
		This is the name of the program that will be use when the NSH ELF
		program is installed.

config SQA_SYSTEM_PRIORITY
	int "Sytem task priority"
	default 100

config SQA_SYSTEM_STACKSIZE
	int "System stack size"
	default 2048


endif
```

## audio_diag/Kconfig
```kconfig
#
# For a description of the syntax of this configuration file,
# see the file kconfig-language.txt in the NuttX tools repository.
#

config TEST_AUDIO_DIAG
    bool "Audio diag test"
    default n
    ---help---
        Enable audio diag test

if TEST_AUDIO_DIAG

config TEST_AUDIO_DIAG_APP_NAME
	string "Application name"
	default "adiag"

config TEST_AUDIO_DIAG_PROGNAME
	string "Program name"
	default "audio_diag"

config TEST_AUDIO_DIAG_PRIORITY
	int "Audio diag task priority"
	default 100

config TEST_AUDIO_DIAG_STACKSIZE
	int "Audio diag stack size"
	default 2048

endif
```

## audio_recorder/Kconfig
```kconfig
#
# For a description of the syntax of this configuration file,
# see the file kconfig-language.txt in the NuttX tools repository.
#

config TEST_AUDIO_RECORDER
    bool "Audio recorder test"
    default n

if TEST_AUDIO_RECORDER

config TEST_AUDIO_RECORDER_APP_NAME
	string "Application name"
	default "recorder"
	
config TEST_AUDIO_RECORDER_PROGNAME
	string "Program name"
	default "audio_recorder"

config TEST_AUDIO_RECORDER_PRIORITY
	int "Audio recorder task priority"
	default 100

config TEST_AUDIO_RECORDER_STACKSIZE
	int "Audio recorder stack size"
	default 2048

config TEST_AUDIO_RECORDER_FILE_MOUNTPT
	string "recording file mount path"
	default "/mnt/sd0/REC"
	---help---
		The path to the recording file mount point. Default: /mnt/vfat/REC

endif
```

## awsiot/Kconfig
```kconfig
#
# For a description of the syntax of this configuration file,
# see the file kconfig-language.txt in the NuttX tools repository.
#

config TEST_AWSIOT
	bool "AWS IoT test"
	default n
	---help---
		Enable the AWS IoT test

if TEST_AWSIOT

config TEST_AWSIOT_PROGNAME
	string "Program name"
	default "awsiot"
	depends on BUILD_KERNEL
	---help---
		This is the name of the program that will be use when the NSH ELF
		program is installed.

config TEST_AWSIOT_PRIORITY
	int "awsiottest task priority"
	default 100

config TEST_AWSIOT_STACKSIZE
	int "awsiottest stack size"
	default 2048

config TEST_AWSIOT_STACKSIZE_IN_USING_MBEDTLS
	int "lte_awsiot stack size in using mbedTLS"
	default 5120

config TEST_AWSIOT_IOT_DEBUG
	bool "enables IOT_DEBUG output"
	default n

config TEST_AWSIOT_IOT_ERROR
	bool "enables IOT_ERROR output"
	default n

config TEST_AWSIOT_APN_NAME
	string "Access Point Name"
	default ""

config TEST_AWSIOT_APN_IPTYPE
	int "IP type"
	default 0
	range 0 2
	---help---
		IP type is selected from IP, IPv6 and IPv4/v6.
		Values are IP=0, IPv6=1 and IPv4/v6=2.

config TEST_AWSIOT_APN_AUTHTYPE
	int "Authentication type"
	default 0
	range 0 2
	---help---
		Authentication type is selected from NONE, PAP and CHAP.
		Values are NONE=0, PAP=1, CHAP=2.

config TEST_AWSIOT_APN_USERNAME
	string "Username used for authentication"
	default ""

config TEST_AWSIOT_APN_PASSWD
	string "Password used for authentication"
	default ""

config TEST_AWSIOT_HOST
	string "AWS IoT server host name"
	default "sample.iot.ap-northeast-1.amazonaws.com"

config TEST_AWSIOT_PORT
	int "AWS IoT server port number"
	default 8883

config TEST_AWSIOT_ROOTCA
	string "AWS IoT server root CA file name"
	default "/mnt/vfat/VeriSignClass3-G5.pem"

config TEST_AWSIOT_CLIENT_CERT
	string "AWS IoT client cert file"
	default "/mnt/vfat/client_aws.crt"

config TEST_AWSIOT_CLIENT_KEY
	string "AWS IoT client key file"
	default "/mnt/vfat/client_aws.key"

endif
```

## fsspeed/Kconfig
```kconfig
#
# For a description of the syntax of this configuration file,
# see the file kconfig-language.txt in the NuttX tools repository.
#

config TEST_FSSPEED
	bool "File system speed test"
	default n
	---help---
		Enable the file system speed test

if TEST_FSSPEED

config TEST_FSSPEED_PROGNAME
	string "Program name"
	default "fsspeed"
	depends on BUILD_KERNEL
	---help---
		This is the name of the program that will be use when the NSH ELF
		program is installed.

config TEST_FSSPEED_PRIORITY
	int "Fsspeed task priority"
	default 100

config TEST_FSSPEED_STACKSIZE
	int "Fsspeed stack size"
	default 2048

endif
```

## internal_test/audio/configs/corvo/decoder_component_test-defconfig
```kconfig
CONFIG_BOARD_CORVO=y
CONFIG_CXD56_GNSS=y
CONFIG_MEMUTILS=y
CONFIG_ASMP=y
CONFIG_TEST_DECODER_COMPONENT=y
```

## lte_socket/api/Kconfig
```kconfig
#
# For a description of the syntax of this configuration file,
# see the file kconfig-language.txt in the NuttX tools repository.
#

config LTE_SOCKTEST_API
	bool "api test"
	default n
	---help---
		Enable the api test

if LTE_SOCKTEST_API

config LTE_SOCKTEST_API_PROGNAME
	string "Program name"
	default "apitest"
	depends on BUILD_KERNEL
	---help---
		This is the name of the program that will be use when the NSH ELF
		program is installed.

config LTE_SOCKTEST_API_PRIORITY
	int "apitest task priority"
	default 100

config LTE_SOCKTEST_API_STACKSIZE
	int "apitest stack size"
	default 2048

endif
```

## lte_socket/dns/Kconfig
```kconfig
#
# For a description of the syntax of this configuration file,
# see the file kconfig-language.txt in the NuttX tools repository.
#

config LTE_SOCKTEST_DNS
	bool "dns test"
	default n
	---help---
		Enable the dns test

if LTE_SOCKTEST_DNS

config LTE_SOCKTEST_DNS_PROGNAME
	string "Program name"
	default "dnstest"
	depends on BUILD_KERNEL
	---help---
		This is the name of the program that will be use when the NSH ELF
		program is installed.

config LTE_SOCKTEST_DNS_PRIORITY
	int "dnstest task priority"
	default 100

config LTE_SOCKTEST_DNS_STACKSIZE
	int "dnstest stack size"
	default 2048

endif
```

## lte_socket/macro/Kconfig
```kconfig
#
# For a description of the syntax of this configuration file,
# see the file kconfig-language.txt in the NuttX tools repository.
#

config LTE_SOCKTEST_MACRO
	bool "macro test"
	default n
	---help---
		Enable the macro test

if LTE_SOCKTEST_MACRO

config LTE_SOCKTEST_MACRO_PROGNAME
	string "Program name"
	default "macrotest"
	depends on BUILD_KERNEL
	---help---
		This is the name of the program that will be use when the NSH ELF
		program is installed.

config LTE_SOCKTEST_MACRO_PRIORITY
	int "macrotest task priority"
	default 100

config LTE_SOCKTEST_MACRO_STACKSIZE
	int "macrotest stack size"
	default 2048

endif
```
