## TestSoftware/sdk/lte/lwm2m/Kconfig
```kconfig
#
# For a description of the syntax of this configuration file,
# see the file kconfig-language.txt in the NuttX tools repository.
#

config TEST_LWM2M
	bool "Lightweight M2M test"
	default n
	---help---
		Enable the Lightweight M2M test

if TEST_LWM2M

config TEST_LWM2M_PROGNAME
	string "Program name"
	default "lwm2m"
	depends on BUILD_KERNEL
	---help---
		This is the name of the program that will be use when the NSH ELF
		program is installed.

config TEST_LWM2M_PRIORITY
	int "lwm2m test task priority"
	default 100

config TEST_LWM2M_STACKSIZE
	int "lwm2m test stack size"
	default 8192

config TEST_LWM2M_APN_NAME
	string "Access Point Name"
	default ""

config TEST_LWM2M_APN_IPTYPE
	int "IP type"
	default 0
	range 0 2
	---help---
		IP type is selected from IP, IPv6 and IPv4/v6.
		Values are IP=0, IPv6=1 and IPv4/v6=2.

config TEST_LWM2M_APN_AUTHTYPE
	int "Authentication type"
	default 0
	range 0 2
	---help---
		Authentication type is selected from NONE, PAP and CHAP.
		Values are NONE=0, PAP=1, CHAP=2.

config TEST_LWM2M_APN_USERNAME
	string "Username used for authentication"
	default ""

config TEST_LWM2M_APN_PASSWD
	string "Password used for authentication"
	default ""

config TEST_LWM2M_CLIENT_NAME
	string "Client name of LwM2M"
	default "testfw-lwm2m"

config TEST_LWM2M_CLIENT_PORT
	string "Client port of LwM2M"
	default "56830"

config TEST_LWM2M_SERVER_HOST
	string "Server host name of LwM2M"
	default "sample.ap-northeast-1.compute.amazonaws.com"

config TEST_LWM2M_SERVER_PORT
	string "Server port number of LwM2M"
	default "5683"

config TEST_LWM2M_LESHAN_IDENTITY
	string "Identify of leshan server"
	default "test-identity"

config TEST_LWM2M_LESHAN_PSK
	string "PSK of leshan server"
	default "5350524553454e5345"

endif
```

## TestSoftware/sdk/lte/mqtt/Kconfig
```kconfig
#
# For a description of the syntax of this configuration file,
# see the file kconfig-language.txt in the NuttX tools repository.
#

config TEST_MQTT
	bool "MQTT test"
	default n
	select EXTERNALS_MQTT
	---help---
		Enable the mqtt test

if TEST_MQTT

config TEST_MQTT_PROGNAME
	string "Program name"
	default "mqtt"
	depends on BUILD_KERNEL
	---help---
		This is the name of the program that will be use when the NSH ELF
		program is installed.

config TEST_MQTT_PRIORITY
	int "mqtt test task priority"
	default 100

config TEST_MQTT_STACKSIZE
	int "mqtt test stack size"
	default 2048

config TEST_MQTT_STACKSIZE_IN_USING_MBEDTLS
	int "lte_mqtt stack size in using mbedTLS"
	default 5120

config TEST_MQTT_APN_NAME
	string "Access Point Name"
	default ""

config TEST_MQTT_APN_IPTYPE
	int "IP type"
	default 0
	range 0 2
	---help---
		IP type is selected from IP, IPv6 and IPv4/v6.
		Values are IP=0, IPv6=1 and IPv4/v6=2.

config TEST_MQTT_APN_AUTHTYPE
	int "Authentication type"
	default 0
	range 0 2
	---help---
		Authentication type is selected from NONE, PAP and CHAP.
		Values are NONE=0, PAP=1, CHAP=2.

config TEST_MQTT_APN_USERNAME
	string "Username used for authentication"
	default ""

config TEST_MQTT_APN_PASSWD
	string "Password used for authentication"
	default ""

config TEST_MQTT_ROOTCA
	string "MQTT server root CA file name"
	default "/mnt/vfat/DSTRootCAX3.crt"

endif
```

## TestSoftware/sdk/mbedTLS/mbedtls/Kconfig
```kconfig
#
# For a description of the syntax of this configuration file,
# see the file kconfig-language.txt in the NuttX tools repository.
#

config SQA_TEST_MBEDTLS
	bool "mbedtls test"
	default n
	---help---
		Enable the mbedtls test

if SQA_TEST_MBEDTLS

config SQA_TEST_MBEDTLS_PROGNAME
	string "Program name"
	default "mbedtls"
	depends on BUILD_KERNEL
	---help---
		This is the name of the program that will be use when the NSH ELF
		program is installed.

config SQA_TEST_MBEDTLS_PRIORITY
	int "mbedtls task priority"
	default 100

config SQA_TEST_MBEDTLS_STACKSIZE
	int "mbedtls stack size"
	default 5120

config SQA_TEST_MBEDTLS_DIGICERT_ROOTCA
	string "DigiCert Global Root CA file"
	default "/mnt/sd0/DigiCertGlobalRootCA.crt"

config SQA_TEST_MBEDTLS_DIGICERT_ROOTG2
	string "DigiCert Global Root G2 file"
	default "/mnt/sd0/DigiCertGlobalRootG2.crt"

config SQA_TEST_MBEDTLS_DIGICERT_HIGH_ROOTCA
	string "DigiCert High Assuarance EV Root CA file"
	default "/mnt/sd0/DigiCertHighAssuaranceEVRootCA.crt"

config SQA_TEST_MBEDTLS_COMODO_ROOTCA
	string "Comodo Root Certificate file"
	default "/mnt/sd0/addtrustexternalcaroot.crt"

endif
```

## TestSoftware/sdk/mbedTLS/mbedtls_dev/Kconfig
```kconfig
#
# For a description of the syntax of this configuration file,
# see the file kconfig-language.txt in the NuttX tools repository.
#

config TEST_MBEDTLS
	bool "mbedtls test"
	default n
	---help---
		Enable the mbedtls test

if TEST_MBEDTLS

config TEST_MBEDTLS_PROGNAME
	string "Program name"
	default "mbedtls"
	depends on BUILD_KERNEL
	---help---
		This is the name of the program that will be use when the NSH ELF
		program is installed.

config TEST_MBEDTLS_PRIORITY
	int "mbedtls task priority"
	default 100

config TEST_MBEDTLS_STACKSIZE
	int "mbedtls stack size"
	default 2048

config TEST_MBEDTLS_DIGICERT_ROOTCA
	string "DigiCert Global Root CA file"
	default "/mnt/vfat/DigiCertGlobalRootCA.crt"

config TEST_MBEDTLS_DIGICERT_ROOTG2
	string "DigiCert Global Root G2 file"
	default "/mnt/vfat/DigiCertGlobalRootG2.crt"

config TEST_MBEDTLS_DIGICERT_HIGH_ROOTCA
	string "DigiCert High Assuarance EV Root CA file"
	default "/mnt/vfat/DigiCertHighAssuaranceEVRootCA.crt"

config TEST_MBEDTLS_COMODO_ROOTCA
	string "Comodo Root Certificate file"
	default "/mnt/vfat/addtrustexternalcaroot.crt"

endif
```

## TestSoftware/sdk/mbedTLS/mbedtls_n/Kconfig
```kconfig
#
# For a description of the syntax of this configuration file,
# see the file kconfig-language.txt in the NuttX tools repository.
#

config TEST_MBEDTLS_N
	bool "mbedtls test"
	default n
	---help---
		Enable the mbedtls test

if TEST_MBEDTLS_N

config TEST_MBEDTLS_N_PROGNAME
	string "Program name"
	default "mbedtls"
	depends on BUILD_KERNEL
	---help---
		This is the name of the program that will be use when the NSH ELF
		program is installed.

config TEST_MBEDTLS_N_PRIORITY
	int "mbedtls task priority"
	default 100

config TEST_MBEDTLS_N_STACKSIZE
	int "mbedtls stack size"
	default 5096 

config TEST_MBEDTLS_N_DIGICERT_ROOTCA
        string "DigiCert Global Root CA file"
        default "/mnt/sd0/DigiCertGlobalRootCA.crt"

config TEST_MBEDTLS_N_DIGICERT_ROOTG2
        string "DigiCert Global Root G2 file"
        default "/mnt/sd0/DigiCertGlobalRootG2.crt"

config TEST_MBEDTLS_N_DIGICERT_HIGH_ROOTCA
        string "DigiCert High Assurance EV Root CA file"
        default "/mnt/sd0/DigiCertHighAssuranceEVRootCA.crt"

config TEST_MBEDTLS_N_COMODO_ROOTCA
        string "Comodo Root Certificate file"
        default "/mnt/sd0/addtrustexternalcaroot.crt"

endif
```

## TestSoftware/sdk/mbedTLS/mbedtls_n/configs/mbedtls-defconfig
```kconfig
CONFIG_CXD56_SDIO=y
CONFIG_CXD56_SPI=y
CONFIG_CXD56_DMAC_SPI4_TX_MAXSIZE=2064
CONFIG_CXD56_DMAC_SPI4_RX_MAXSIZE=2064
CONFIG_CXD56_LTE=y
CONFIG_MODEM=y
CONFIG_LTE=y
CONFIG_LTE_NET_MBEDTLS=y
CONFIG_LTE_NET=y
CONFIG_LTE_INET=y
CONFIG_LTE_INET_ATON=y
CONFIG_LTE_NETDB=y
CONFIG_NSH_LINELEN=256
CONFIG_NSH_MAXARGUMENTS=8
CONFIG_SYSTEM_PMIC=y
CONFIG_TEST_LTEAPI=y
CONFIG_TEST_MBEDTLS_N=y
```

## TestSoftware/sdk/multicpu/multicpu_sec/Kconfig
```kconfig
#
# For a description of the syntax of this configuration file,
# see the file kconfig-language.txt in the NuttX tools repository.
#

config TEST_MULTICPU_SEC
	bool "Resource sharing test between CPUs using ASMP plus secure"
	default n
```

## TestSoftware/sdk/other/internal_test/audio/component_test/decoder/decoder_component_test/Kconfig
```kconfig
#
# For a description of the syntax of this configuration file,
# see the file kconfig-language.txt in the NuttX tools repository.
#

config TEST_DECODER_COMPONENT
	bool "decode component test"
	default n
	select MEMUTILS_MEMORY_MANAGER
	select MEMUTILS_MESSAGE
	select MEMUTILS_S_STL
	select MEMUTILS_SIMPLE_FIFO


config TEST_DECODER_COMPONENT_PROGNAME
	string "Program name"
	default "test_decoder_component"
	depends on TEST_DECODER_COMPONENT

config TEST_DECODER_COMPONENT_PRIORITY
	int "Test decoder task priority"
	default 100
	depends on TEST_DECODER_COMPONENT

config TEST_DECODER_COMPONEN_STACKSIZE
	int "Test decoder stack size"
	default 4096
	depends on TEST_DECODER_COMPONENT

config TEST_DECODER_FILE_MOUNTPT
	string "Test contents file mount path"
	default "/mnt/vfat/AUDIO"
	depends on TEST_DECODER_COMPONENT
	---help---
		The path to the play file mount point. Default: /mnt/vfat/AUDIO

config AUDIOUTILS_PLAYLIST_PLAYLISTFILE_MOUNTPT
	string "test playlist file mount path"
	default "/mnt/vfat/PLAYLIST"
	depends on TEST_DECODER_COMPONENT
	---help---
		The path to the playlist file mount point. Default: /mnt/vfat/PLAYLIST

config AUDIOUTILS_DSP_MOUNTPT
	string "DSP image mount path"
	default "/mnt/vfat/BIN"
	depends on TEST_DECODER_COMPONENT
	---help---
		The path to the DSP mount point. Default: /mnt/vfat/BIN"

config TEST_DECODER_OUTPUT_FILE_MOUNTPT
	string "decoding file mount path"
	default "/mnt/vfat/DEC"
	depends on TEST_DECODER_COMPONENT
	---help---
		The path to the recording file mount point. Default: /mnt/vfat/DEC

config AUDIOUTILS_DSP_DEBUG_DUMP
	bool "dsp debug dump"
	default n
	depends on TEST_DECODER_COMPONENT && CXD56_LOG
	---help---
		Enable Dsp Debug Dump
```
