## TestSoftware/sdk/combination/recognizer_player/Kconfig
```kconfig
#
# For a description of the syntax of this configuration file,
# see the file kconfig-language.txt in the NuttX tools repository.
#

config SQA_COMBI_RECOG_PLAYER
	bool "Audio recognizer and player"
	default n
	depends on CXD56_AUDIO
	---help---
		Enable the audio recognizer and player

if SQA_COMBI_RECOG_PLAYER

config SQA_COMBI_RECOG_PLAYER_PROGNAME
	string "Program name"
	default "recognizer_player"

config SQA_COMBI_RECOG_PLAYER_PRIORITY
	int "Audio recognizer task priority"
	default 100

config SQA_COMBI_RECOG_PLAYER_STACKSIZE
	int "Audio recognizer stack size"
	default 2048

choice
	prompt "Pre process"
    default SQA_COMBI_RECOG_PLAYER_THROUGH
	---help---
        Select pre process which is applied at Frontend
   
config SQA_COMBI_RECOG_PLAYER_USEPREPROC
	bool "User custom process"
	---help---
	    Use user custom process at Frontend

config SQA_COMBI_RECOG_PLAYER_SAMPLERATECONV
	bool "Sample rate converter"
	---help---
	    Use sample rate converter at Frontend

config SQA_COMBI_RECOG_PLAYER_THROUGH
	bool "Through"
	---help---
	    No signal processing is applied at Frontend

endchoice

endif
```

## TestSoftware/sdk/combination/recognizer_recorder/Kconfig
```kconfig
#
# For a description of the syntax of this configuration file,
# see the file kconfig-language.txt in the NuttX tools repository.
#

config SQA_COMBI_RECOG_RECORDER
	bool "Audio recognizer and recorder"
	default n
	depends on CXD56_AUDIO
	---help---
		Enable the audio recognizer and recorder

if SQA_COMBI_RECOG_RECORDER

config SQA_COMBI_RECOG_RECORDER_PROGNAME
	string "Program name"
	default "recognizer_recorder"

config SQA_COMBI_RECOG_RECORDER_PRIORITY
	int "Audio recognizer task priority"
	default 100

config SQA_COMBI_RECOG_RECORDER_STACKSIZE
	int "Audio recognizer stack size"
	default 2048

choice
	prompt "Pre process"
    default SQA_COMBI_RECOG_RECORDER_THROUGH
	---help---
        Select pre process which is applied at Frontend
   
config SQA_COMBI_RECOG_RECORDER_USEPREPROC
	bool "User custom process"
	---help---
	    Use user custom process at Frontend

config SQA_COMBI_RECOG_RECORDER_SAMPLERATECONV
	bool "Sample rate converter"
	---help---
	    Use sample rate converter at Frontend

config SQA_COMBI_RECOG_RECORDER_THROUGH
	bool "Through"
	---help---
	    No signal processing is applied at Frontend

endchoice

endif
```

## TestSoftware/sdk/combination/step_audio_lte/Kconfig
```kconfig
#
# For a description of the syntax of this configuration file,
# see the file kconfig-language.txt in the NuttX tools repository.
#

config TEST_SENSOR_STEP_COUNTER
	bool "Step counter and Audio and LTE combination test"
	default n
	select NETUTILS_JSON
	select NETUTILS_HTTPC
	---help---
		Enable the step_counter sensor example

if TEST_SENSOR_STEP_COUNTER

config TEST_STEP_COUNTER_PROGNAME
	string "Program name"
	default "step_counter"
	depends on BUILD_KERNEL
	---help---
		This is the name of the program that will be use when the NSH ELF
		program is installed.

config TEST_STEP_COUNTER_PRIORITY
	int "Sensor task priority"
	default 100

config TEST_STEP_COUNTER_STACKSIZE
	int "Sensor stack size"
	default 4096

config TEST_SENSOR_STEP_COUNTER_ACCEL_WM_SIGNO
    int "Accelerator sensor watermark signal"
    default 14

endif
```

## TestSoftware/sdk/combination/tracker/Kconfig
```kconfig
#
# For a description of the syntax of this configuration file,
# see the file kconfig-language.txt in the NuttX tools repository.
#

config DEMO_COLLET_TRACKER
	bool "collet tracker demo"
	default n
#	select LTE
#	select LTE_CLIENT
#	select EXTNETUTILS
#	select EXTNETUTILS_JSON
        select NETUTILS_JSON
	select NETUTILS_HTTPC
#	select NETUTILS_MBEDTLS
	select LIBC_FLOATINGPOINT
#	select SENSORS
#	select BMP280
#	select AK09912
#	select BMI160
	select MEMUTILS
	select MEMUTILS_MEMORY_MANAGER
	select MEMUTILS_MESSAGE
#	select SENSING_MANAGER
#	select SENSING_TRAM
#	select SENSING_BAROMETER
	select CXD56_SCU
	select CXD56_GNSS

if DEMO_COLLET_TRACKER

config DEMO_COLLET_TRACKER_PROGNAME
	string "Program name"
	default "collet_tracker"
	depends on BUILD_KERNEL
	---help---
		This is the name of the program that will be use when the NSH ELF
		program is installed.

config DEMO_COLLET_TRACKER_PRIORITY
	int "collet tracker task priority"
	default 100

config DEMO_COLLET_TRACKER_STACKSIZE
	int "collet tracker stack size"
	default 5120

config DEMO_COLLET_TRACKER_HTTP_CUSTOM_HEADER_NUM
	int "Max number of custom headers"
	default 5

config DEMO_COLLET_TRACKER_USING_NXFB
	bool "Using NX graphics with frame buffer"
	default y

config DEMO_COLLET_TRACKER_ACCEL_TM_SIGNO
	int "Accelerator sensor's inner timer signal"
	default 15

config DEMO_COLLET_TRACKER_ACCEL_WM_SIGNO
	int "Accelerator sensor signal for waterMark"
	default 14
    
config DEMO_COLLET_TRACKER_ACCEL_EV_SIGNO
	int "Accelerator sensor signal for event"
	default 13

config DEMO_COLLET_TRACKER_MAG_SIGNO
	int "Magnetometer sensor signal"
	default 12
    
config DEMO_COLLET_TRACKER_PRESS_SIGNO
	int "Pressure sensor signal"
	default 11
    
config DEMO_COLLET_TRACKER_TEMP_SIGNO
	int "Temperature sensor signal"
	default 10

config DEMO_COLLET_TRACKER_DEBUG_FEATURES
	bool "Enable Debug Features for tracker demo application"
	default n

if DEMO_COLLET_TRACKER_DEBUG_FEATURES

config DEMO_COLLET_TRACKER_DEBUG_ERROR
	bool "Enable Error Output"
	default n

config DEMO_COLLET_TRACKER_DEBUG_WARN
	bool "Enable Warnigs Output"
	default n
	depends on DEMO_COLLET_TRACKER_DEBUG_ERROR

config DEMO_COLLET_TRACKER_DEBUG_INFO
	bool "Enable Infomation Debug Output"
	default n
	depends on DEMO_COLLET_TRACKER_DEBUG_WARN

endif # DEMO_COLLET_TRACKER_DEBUG_FEATURES
endif # DEMO_COLLET_TRACKER
```

## TestSoftware/sdk/dnnrt/dnnrt_multi/Kconfig
```kconfig
#
# For a description of the syntax of this configuration file,
# see the file kconfig-language.txt in the NuttX tools repository.
#

config EXAMPLES_DNNRT_MULTI
	bool "dnnrt_multi example using LeNet-5"
    depends on DNN_RT
	default n
	---help---
		classify MNIST digits by LeNet-5

if EXAMPLES_DNNRT_MULTI

config EXAMPLES_DNNRT_MULTI_PROGNAME
	string "Program name"
	default "dnnrt_multi"
	depends on BUILD_KERNEL
	---help---
		This is the name of the program that will be use when the NSH ELF
		program is installed.

config EXAMPLES_DNNRT_MULTI_PRIORITY
	int "dnnrt_paramtest task priority"
	default 100

config EXAMPLES_DNNRT_MULTI_STACKSIZE
	int "dnnrt_paramtest stack size"
	default 2048

endif
```

## TestSoftware/sdk/dnnrt/dnnrt_multi/config/dnnrt_multi-defconfig
```kconfig
CONFIG_CXD56_SDIO=y
CONFIG_ASMP=y
CONFIG_DNN_RT=y
CONFIG_DNN_RT_MP=y
CONFIG_EXAMPLES_DNNRT_LENET=y
CONFIG_EXAMPLES_DNNRT_MULTI=y
CONFIG_EXTERNALS_CMSIS=y
```

## TestSoftware/sdk/dnnrt/dnnrt_paramtest/Kconfig
```kconfig
#
# For a description of the syntax of this configuration file,
# see the file kconfig-language.txt in the NuttX tools repository.
#

config EXAMPLES_DNNRT_PARAMTEST
	bool "dnnrt example of pramtest using LeNet-5"
    depends on DNN_RT
	default n
	---help---
		classify MNIST digits by LeNet-5

if EXAMPLES_DNNRT_PARAMTEST

config EXAMPLES_DNNRT_PARAMTEST_PROGNAME
	string "Program name"
	default "dnnrt_paramtest"
	depends on BUILD_KERNEL
	---help---
		This is the name of the program that will be use when the NSH ELF
		program is installed.

config EXAMPLES_DNNRT_PARAMTEST_PRIORITY
	int "dnnrt_paramtest task priority"
	default 100

config EXAMPLES_DNNRT_PARAMTEST_STACKSIZE
	int "dnnrt_paramtest stack size"
	default 2048

endif
```

## TestSoftware/sdk/gnss/gnss/Kconfig
```kconfig
#
# For a description of the syntax of this configuration file,
# see the file kconfig-language.txt in the NuttX tools repository.
#

config EXAMPLES_GNSS_TEST
	bool "GNSS test"
	default n
  depends on CXD56_GNSS
	---help---
		Enable the Simple GNSS positioning example

if EXAMPLES_GNSS_TEST

config EXAMPLES_GNSS_TEST_PROGNAME
	string "Program name"
	default "gnss_test"
	depends on BUILD_KERNEL
	---help---
		This is the name of the program that will be use when the NSH ELF
		program is installed.

config EXAMPLES_GNSS_TEST_PRIORITY
	int "GNSS task priority"
	default 100

config EXAMPLES_GNSS_TEST_STACKSIZE
	int "GNSS stack size"
	default 2048

config EXAMPLES_GNSS_TEST_PVTLOG_FILEPATH
	string "path to save the log file"
	default "/mnt/spif/PVTLOG"
	---help---
		Specify the path to save the log file.

endif
```

## TestSoftware/sdk/gnss/gnss_extension_test/Kconfig
```kconfig
#
# For a description of the syntax of this configuration file,
# see the file kconfig-language.txt in the NuttX tools repository.
#

config EXAMPLES_GNSS_EXTENSION_TEST
	bool "GNSS_EXTENSION_TEST positioning example"
	default n
  depends on CXD56_GNSS
	---help---
		Enable the Simple GNSS positioning example

if EXAMPLES_GNSS_EXTENSION_TEST

config EXAMPLES_GNSS_EXTENSION_TEST_PROGNAME
	string "Program name"
	default "gnss_extension"
	depends on BUILD_KERNEL
	---help---
		This is the name of the program that will be use when the NSH ELF
		program is installed.

config EXAMPLES_GNSS_EXTENSION_TEST_PRIORITY
	int "GNSS task priority"
	default 100

config EXAMPLES_GNSS_EXTENSION_TEST_STACKSIZE
	int "GNSS stack size"
	default 81920

choice
	prompt "Event notification"
	default EXAMPLES_GNSS_EXTENSION_TEST_USE_POLL

config EXAMPLES_GNSS_EXTENSION_TEST_USE_POLL
	bool "Polling notifycation"

config EXAMPLES_GNSS_EXTENSION_TEST_USE_SIGNAL
	bool "Signal notifycation"

endchoice # Event notification

endif
```

## TestSoftware/sdk/gnss/gnss_ioctl/Kconfig
```kconfig
#
# For a description of the syntax of this configuration file,
# see the file kconfig-language.txt in the NuttX tools repository.
# Event notification POLL only.
#
config EXAMPLES_GNSS_IOCTL
	bool "GNSS_IOCTL ioctl test"
	default n
  depends on CXD56_GNSS
	---help---
		Enable the GNSS_IOCTL function test

if EXAMPLES_GNSS_IOCTL

config EXAMPLES_GNSS_IOCTL_PROGNAME
	string "Program name"
	default "gnss_ioctl"
	depends on BUILD_KERNEL
	---help---
		This is the name of the program that will be use when the NSH ELF
		program is installed.

config EXAMPLES_GNSS_IOCTL_PRIORITY
	int "GNSS_IOCTL task priority"
	default 100

config EXAMPLES_GNSS_IOCTL_STACKSIZE
	int "GNSS_IOCTL stack size"
	default 2048

endif
```

## TestSoftware/sdk/gnss/gnss_navmsg/Kconfig
```kconfig
#
# For a description of the syntax of this configuration file,
# see the file kconfig-language.txt in the NuttX tools repository.
#

config EXAMPLES_GNSS_NAVMSG
	bool "GNSS example output navigation messages"
	default n
	depends on CXD56_GNSS

if EXAMPLES_GNSS_NAVMSG

config EXAMPLES_GNSS_NAVMSG_PROGNAME
	string "Program name"
	default "gnss_navmsg"
	depends on BUILD_KERNEL
	---help---
		This is the name of the program that will be use when the NSH ELF
		program is installed.

config EXAMPLES_NAVMSG_PRIORITY
	int "NavMsg output task priority"
	default 100

config EXAMPLES_NAVMSG_STACKSIZE
	int "NavMsg output stack size"
	default 2048

config EXAMPLES_NAVMSG_REALTIME_GPSEPH
	bool "NavMsg output GPS ephemeris in real time"
	default n

endif
```

## TestSoftware/sdk/imager/camera/Kconfig
```kconfig
#
# For a description of the syntax of this configuration file,
# see the file kconfig-language.txt in the NuttX tools repository.
#

config SQA_CAMERA
	bool "Camera example"
	default n
	---help---
		Enable the camera example

if SQA_CAMERA

config SQA_CAMERA_PROGNAME
	string "Program name"
	default "camera"
	depends on BUILD_KERNEL
	---help---
		This is the name of the program that will be use when the NSH ELF
		program is installed.

config SQA_CAMERA_PRIORITY
	int "Camera task priority"
	default 100

config SQA_CAMERA_STACKSIZE
	int "Camera stack size"
	default 2048

config BUFNUM_TEST
	bool "Camera buffer num"
	default n

config BUFNUM_NORMAL
	bool "Camera buffer num"
	default y

endif
```

## TestSoftware/sdk/imager/nxframerate/Kconfig
```kconfig
#
# For a description of the syntax of this configuration file,
# see the file kconfig-language.txt in the NuttX tools repository.
#

config TEST_NXFRAMERATE
	bool "NX and LCD framerate meaturement"
	default n
	---help---
		Enable the framerate measurement test

if TEST_NXFRAMERATE

config TEST_NXFRAMERATE_PROGNAME
	string "Program name"
	default "nxframerate"
	depends on BUILD_KERNEL
	---help---
		This is the name of the program that will be use when the NSH ELF
		program is installed.

config TEST_NXFRAMERATE_PRIORITY
	int "Test task priority"
	default 100

config TEST_NXFRAMERATE_STACKSIZE
	int "Test stack size"
	default 2048

endif
```

## TestSoftware/sdk/jpegdecoder/jpeg_decode/Kconfig
```kconfig
#
# For a description of the syntax of this configuration file,
# see the file kconfig-language.txt in the NuttX tools repository.
#

config SQA_JPEG_DECODE
	bool "JPEG decode sqa test app"
	default n
	---help---
		Enable the JPEG decode example

if SQA_JPEG_DECODE

config SQA_JPEG_DECODE_PROGNAME
	string "Program name"
	default "jpeg_decode"
	depends on BUILD_KERNEL
	---help---
		This is the name of the program that will be use when the NSH ELF
		program is installed.

config SQA_JPEG_DECODE_PRIORITY
	int "JPEG decode task priority"
	default 100

config SQA_JPEG_DECODE_STACKSIZE
	int "JPEG decode stack size"
	default 3072

config SQA_JPEG_DECODE_OUTPUT_LCD
	bool "Output LCD"

config SQA_JPEG_DECODE_OUTPUT_YUV_FILE
	bool "Output YUV File"

config SQA_JPEG_DECODE_OUTPUT_YUV_CHECKSUM
	bool "Output YUV CheckSum"

endif
```

## TestSoftware/sdk/lte/iperf3/Kconfig
```kconfig
#
# For a description of the syntax of this configuration file,
# see the file kconfig-language.txt in the NuttX tools repository.
#

config EXAMPLES_IPERF3
	bool "iperf3 example"
	default n
	---help---
		Enable the iperf3

if EXAMPLES_IPERF3

config EXAMPLES_IPERF3_PROGNAME
	string "Program name"
	default "iperf3"
	depends on BUILD_KERNEL
	---help---
		This is the name of the program that will be use when the NSH ELF
		program is installed.

config EXAMPLES_IPERF3_PRIORITY
	int "iperf test task priority"
	default 100

config EXAMPLES_IPERF3_STACKSIZE
	int "iperf test stack size"
	default 4096

endif
```

## TestSoftware/sdk/lte/lte_socket/echo/Kconfig
```kconfig
#
# For a description of the syntax of this configuration file,
# see the file kconfig-language.txt in the NuttX tools repository.
#

config LTE_SOCKTEST_ECHO
	bool "echo test"
	default n
	---help---
		Enable the echo test

if LTE_SOCKTEST_ECHO

config LTE_SOCKTEST_ECHO_PROGNAME
	string "Program name"
	default "echotest"
	depends on BUILD_KERNEL
	---help---
		This is the name of the program that will be use when the NSH ELF
		program is installed.

config LTE_SOCKTEST_ECHO_PRIORITY
	int "echotest task priority"
	default 100

config LTE_SOCKTEST_ECHO_STACKSIZE
	int "echotest stack size"
	default 2048

endif
```
