## TestScript/arduino/camera/camera_arduino_test/defconfig/camera-defconfig
```kconfig
CONFIG_CXD56_SPI=y
CONFIG_CXD56_SPI4=y
CONFIG_CXD56_DMAC_SPI4_TX=y
CONFIG_CXD56_DMAC_SPI4_RX=y
CONFIG_LCD=y
CONFIG_LCD_ILI9340=y
CONFIG_LCD_ILI9340_IFACE0=y
CONFIG_CXD56_I2C=y
CONFIG_CXD56_I2C2=y
CONFIG_CXD56_CISIF=y
CONFIG_VIDEO=y
CONFIG_VIDEO_ISX012=y
CONFIG_CXD56_SDIO=y
CONFIG_SQA_CAMERA=y
```

## TestScript/sdk/audio/audio_data_test/defconfig/player-defconfig
```kconfig
CONFIG_SDK_USER_ENTRYPOINT="spresense_main"
CONFIG_CXD56_SDIO=y
CONFIG_CXD56_EMMC=y
CONFIG_CXD56_SPI=y
CONFIG_CXD56_SPI4=y
CONFIG_CXD56_SPI5=y
CONFIG_CXD56_I2C=y
CONFIG_CXD56_I2C0=y
# CONFIG_CXD56_I2C0_SCUSEQ is not set
CONFIG_CXD56_AUDIO=y
CONFIG_SDK_AUDIO=y
CONFIG_AUDIOUTILS_PLAYER=y
CONFIG_AUDIOUTILS_PLAYLIST=y
CONFIG_MEMUTILS=y
CONFIG_ASMP=y
CONFIG_EXAMPLES_AUDIO_PLAYER=y
```

## TestScript/sdk/audio/audio_extensions_test/defconfig/audio_extensions_test-defconfig
```kconfig
CONFIG_CXD56_SDIO=y
CONFIG_CXD56_AUDIO=y
CONFIG_SDK_AUDIO=y
CONFIG_AUDIOUTILS_PLAYER=y
CONFIG_AUDIOUTILS_RECORDER=y
CONFIG_MEMUTILS=y
CONFIG_ASMP=y
CONFIG_AUDIO_EXTENSIONS_TEST=y
CONFIG_SYSTEM_ZMODEM=y
CONFIG_SYSTEM_ZMODEM_DEVNAME="/dev/console"
CONFIG_SYSTEM_ZMODEM_MOUNTPOINT="/mnt/sd0"
CONFIG_SYSTEM_ZMODEM_PKTBUFSIZE=2048
CONFIG_SYSTEM_ZMODEM_RCVBUFSIZE=2048
```

## TestScript/sdk/audio/audio_player_extensions_test/defconfig/zmodem-defconfig
```kconfig
CONFIG_SYSTEM_ZMODEM=y
CONFIG_SYSTEM_ZMODEM_DEVNAME="/dev/console"
CONFIG_SYSTEM_ZMODEM_MOUNTPOINT="/mnt/sd0"
CONFIG_SYSTEM_ZMODEM_PKTBUFSIZE=2048
CONFIG_SYSTEM_ZMODEM_RCVBUFSIZE=2048
```

## TestScript/sdk/audio/audio_recorder_digmic_wav_test/defconfig/recorder_digmic_wav_test-defconfig
```kconfig
CONFIG_CXD56_SPH=y
CONFIG_CXD56_SDIO=y
CONFIG_CXD56_AUDIO=y
CONFIG_CXD56_I2S0=y
CONFIG_SDK_AUDIO=y
CONFIG_CXD56_AUDIO_MIC_CHANNEL_SEL=0xCBA98765
CONFIG_AUDIOUTILS_RECORDER=y
CONFIG_MEMUTILS=y
CONFIG_ASMP=y
CONFIG_SYSTEM_ZMODEM=y
CONFIG_SYSTEM_ZMODEM_DEVNAME="/dev/console"
CONFIG_SYSTEM_ZMODEM_MOUNTPOINT="/mnt/sd0"
CONFIG_SYSTEM_ZMODEM_PKTBUFSIZE=2048
CONFIG_SYSTEM_ZMODEM_RCVBUFSIZE=2048
CONFIG_SQA_TEST_AUDIO_RECORDER_DIGMIC_WAV=y
CONFIG_SQA_TEST_AUDIO_RECORDER_DIGMIC_WAV_PROGNAME="audio_recorder_digmic_wav"
CONFIG_SQA_TEST_AUDIO_RECORDER_DIGMIC_WAV_PRIORITY=100
CONFIG_SQA_TEST_AUDIO_RECORDER_DIGMIC_WAV_STACKSIZE=2048
```

## TestScript/sdk/audio/audio_recorder_preproc_digmic/defconfig/recorder_preproc_digmic-defconfig
```kconfig
CONFIG_CXD56_SPH=y
CONFIG_CXD56_SDIO=y
CONFIG_CXD56_AUDIO=y
CONFIG_SDK_AUDIO=y
CONFIG_CXD56_AUDIO_MIC_CHANNEL_SEL=0xCBA98765
CONFIG_AUDIOUTILS_RECORDER=y
CONFIG_AUDIOUTILS_DSP_MOUNTPT="/mnt/sd0/BIN"
CONFIG_MEMUTILS=y
CONFIG_ASMP=y
CONFIG_SQA_TEST_AUDIO_RECORDER_PREPROC_DIGMIC=y
CONFIG_SQA_TEST_AUDIO_RECORDER_PREPROC_DIGMIC_PROGNAME="audio_recorder"
CONFIG_SQA_TEST_AUDIO_RECORDER_PREPROC_DIGMIC_PRIORITY=100
CONFIG_SQA_TEST_AUDIO_RECORDER_PREPROC_DIGMIC_STACKSIZE=2048
CONFIG_SQA_TEST_AUDIO_RECORDER_PREPROC_DIGMIC_USEPREPROC=y
CONFIG_SQA_TEST_AUDIO_RECORDER_PREPROC_DIGMIC_USBMSC=y
```

## TestScript/sdk/audio/audio_recorder_preproc_error/defconfig/recorder_preproc-defconfig
```kconfig
CONFIG_CXD56_SDIO=y
CONFIG_CXD56_AUDIO=y
CONFIG_SDK_AUDIO=y
CONFIG_AUDIOUTILS_RECORDER=y
CONFIG_AUDIOUTILS_DSP_MOUNTPT="/mnt/sd0/BIN"
CONFIG_MEMUTILS=y
CONFIG_ASMP=y
CONFIG_SQA_TEST_AUDIO_RECORDER_PREPROC=y
CONFIG_SQA_TEST_AUDIO_RECORDER_PREPROC_PROGNAME="audio_recorder"
CONFIG_SQA_TEST_AUDIO_RECORDER_PREPROC_PRIORITY=100
CONFIG_SQA_TEST_AUDIO_RECORDER_PREPROC_STACKSIZE=2048
CONFIG_SQA_TEST_AUDIO_RECORDER_PREPROC_USEPREPROC=y
CONFIG_SYSTEM_USBMSC=y
```

## TestScript/sdk/audio/audio_recorder_without_frontend/defconfig/recorder_without_frontend-defconfig
```kconfig
CONFIG_CXD56_SPH=y
CONFIG_CXD56_SDIO=y
CONFIG_CXD56_AUDIO=y
CONFIG_SDK_AUDIO=y
CONFIG_AUDIOUTILS_RECORDER=y
CONFIG_AUDIOUTILS_DSP_MOUNTPT="/mnt/sd0/BIN"
CONFIG_MEMUTILS=y
CONFIG_ASMP=y
CONFIG_SQA_TEST_AUDIO_RECORDER_1_2_1=y
CONFIG_SYSTEM_USBMSC=y
```

## TestScript/sdk/gnss/gnss_extension_test/defconfig/gnss_extension-defconfig
```kconfig
CONFIG_CXD56_GNSS=y
CONFIG_GPSUTILS_CXD56NMEA_LIB=y



CONFIG_CXD56_SDIO=y
CONFIG_CXD56_SDIO_DMA=y


CONFIG_CXD56_GNSS_NPOLLWAITERS=4
CONFIG_CXD56_GNSS_NSIGNALRECEIVERS=4
CONFIG_CXD56_GNSS_WORKER_STACKSIZE=128
CONFIG_CXD56_GNSS_WORKER_THREAD_PRIORITY=255
CONFIG_CXD56_GNSS_BACKUP_FILENAME="/mnt/spif/gnss_backup.bin"
CONFIG_CXD56_GNSS_CEP_FILENAME="/mnt/vfat/gnss_cep.bin"
CONFIG_CXD56_GNSS_FW_RTK=y
CONFIG_CXD56_GNSS_DEBUG_FEATURE=y
CONFIG_CXD56_GNSS_DEBUG_ERROR=y
CONFIG_CXD56_GNSS_DEBUG_WARN=y
CONFIG_CXD56_GNSS_DEBUG_INFO=y
CONFIG_CXD56_GEOFENCE=y

CONFIG_EXAMPLES_GNSS_EXTENSION_TEST=y
CONFIG_EXAMPLES_GNSS_EXTENSION_TEST_PRIORITY=100
CONFIG_EXAMPLES_GNSS_EXTENSION_TEST_STACKSIZE=81920
CONFIG_EXAMPLES_GNSS_EXTENSION_TEST_USE_POLL=y
```

## TestScript/sdk/mbedTLS/mbedtls/defconfig/mbedtls-defconfig
```kconfig
CONFIG_EXAMPLES_LTE_TLS=n
CONFIG_CXD56_SPI4=y
CONFIG_CXD56_DMAC_SPI4_TX=y
CONFIG_CXD56_DMAC_SPI4_TX_CH=2
CONFIG_CXD56_DMAC_SPI4_TX_MAXSIZE=2064
CONFIG_CXD56_DMAC_SPI4_RX=y
CONFIG_CXD56_DMAC_SPI4_RX_CH=3
CONFIG_CXD56_DMAC_SPI4_RX_MAXSIZE=2064
CONFIG_SYSTEM_ZMODEM=y
CONFIG_SYSTEM_ZMODEM_DEVNAME="/dev/console"
CONFIG_SYSTEM_ZMODEM_MOUNTPOINT="/mnt/sd0"
CONFIG_SYSTEM_ZMODEM_PKTBUFSIZE=2048
CONFIG_SYSTEM_ZMODEM_RCVBUFSIZE=2048
CONFIG_SQA_TEST_MBEDTLS=y
CONFIG_SQA_TEST_MBEDTLS_PRIORITY=100
CONFIG_SQA_TEST_MBEDTLS_STACKSIZE=5120
CONFIG_SQA_TEST_MBEDTLS_DIGICERT_ROOTCA="/mnt/sd0/DigiCertGlobalRootCA.crt"
CONFIG_SQA_TEST_MBEDTLS_DIGICERT_ROOTG2="/mnt/sd0/DigiCertGlobalRootG2.crt"
CONFIG_SQA_TEST_MBEDTLS_DIGICERT_HIGH_ROOTCA="/mnt/sd0/DigiCertHighAssuaranceEVRootCA.crt"
CONFIG_SQA_TEST_MBEDTLS_COMODO_ROOTCA="/mnt/sd0/addtrustexternalcaroot.crt"
```

## TestScript/sdk/os/ostest16593_test/defconfig/ostest-defconfig
```kconfig
#RTOS Features 
# [*] Enable priority inheritance   ---> 
#
#RTOS Features > Pthread Options
#	[*] Enable mutex types           
#	[*] pthread cleanup stack    
#
#File Systems --
#     [*] Named semaphore support  


CONFIG_EXAMPLES_OSTEST=y
CONFIG_EXAMPLES_OSTEST_LOOPS=1
CONFIG_EXAMPLES_OSTEST_STACKSIZE=8192
CONFIG_EXAMPLES_OSTEST_NBARRIER_THREADS=8
CONFIG_EXAMPLES_OSTEST_RR_RANGE=10000
CONFIG_EXAMPLES_OSTEST_RR_RUNS=10
```

## TestScript/sdk/sample/fwupdate_example_test/defconfig/fwupdate-defconfig
```kconfig
CONFIG_FWUPUTILS=y
CONFIG_FWUPUTILS_MANAGER=y
CONFIG_FWUPUTILS_CLIENTS=y
CONFIG_EXAMPLES_FWUPDATE=y
# CONFIG_EXAMPLES_FWUPDATE_USBCDC_ZMODEM is not set
CONFIG_CXD56_SDIO=y
```

## TestScript/sdk/sample/jpeg_decode16614_example_test/defconfig/jpeg_decodeLCD-defconfig
```kconfig
CONFIG_CXD56_SPI=y
CONFIG_CXD56_SPI4=y
CONFIG_CXD56_DMAC_SPI4_TX=y
CONFIG_CXD56_DMAC_SPI4_RX=y
CONFIG_LCD=y
CONFIG_LCD_ILI9340=y
CONFIG_LCD_ILI9340_IFACE0=y

CONFIG_CXD56_SDIO=y
CONFIG_EXTERNALS_LIBJPEG=y
CONFIG_EXAMPLES_JPEG_DECODE=y
CONFIG_EXAMPLES_JPEG_DECODE_STACKSIZE=2048
CONFIG_EXAMPLES_JPEG_DECODE_OUTPUT_LCD=y

CONFIG_NETUTILS_CODECS=y
CONFIG_CODECS_HASH_MD5=y
```

## TestScript/sdk/sample/press_example_test/defconfig/press-defconfig
```kconfig
CONFIG_CXD56_I2C=y
CONFIG_CXD56_I2C0=y
CONFIG_SENSORS=y
CONFIG_BMP280=y
CONFIG_EXAMPLES_PRESS=y
```

## TestScript/sdk/system/fat/hello/Kconfig
```kconfig
#
# For a description of the syntax of this configuration file,
# see the file kconfig-language.txt in the NuttX tools repository.
#

config EXAMPLES_HELLO
	bool "Fat test example"
	default n
	---help---
		Enable the Fat test example

if EXAMPLES_FAT

config EXAMPLES_FAT_PROGNAME
	string "Program name"
	default "fat"
	depends on BUILD_KERNEL
	---help---
		This is the name of the program that will be use when the NSH ELF
		program is installed.

config EXAMPLES_FAT_PRIORITY
	int "fat task priority"
	default 100

config EXAMPLES_FAT_STACKSIZE
	int "Hello stack size"
	default 2048

endif
```

## TestScript/sdk/system/flashManage14967_test/defconfig/flashManage14967-defconfig
```kconfig
CONFIG_CXD56_GNSS=y
CONFIG_GPSUTILS_CXD56NMEA_LIB=y
CONFIG_EXAMPLES_GNSS=y
CONFIG_CXD56_GNSS=y
CONFIG_GPSUTILS_CXD56NMEA_LIB=y
CONFIG_EXAMPLES_GNSS_ATCMD=y
CONFIG_CXD56_GNSS=y
CONFIG_GPSUTILS_CXD56NMEA_LIB=y
CONFIG_EXAMPLES_GNSS_FACTORY=y
CONFIG_CXD56_GNSS=y
CONFIG_GPSUTILS_CXD56NMEA_LIB=y
CONFIG_EXAMPLES_GNSS_PVTLOG=y
CONFIG_CXD56_GNSS=y
CONFIG_GPSUTILS_CXD56NMEA_LIB=y
CONFIG_EXAMPLES_GEOFENCE=y
```

## TestSoftware/sdk/aesm/asmp_extensions/Kconfig
```kconfig
#
# For a description of the syntax of this configuration file,
# see the file kconfig-language.txt in the NuttX tools repository.
#

config TEST_ASMP_EXTENSIONS
	bool "ASMP Extensions Test"
	default n
```
